## Kconfig.shield
```kconfig
config SHIELD_CORNE_LEFT
	def_bool $(shields_list_contains,Luci_Keeb_left)

config SHIELD_CORNE_RIGHT
	def_bool $(shields_list_contains,Luci_Keeb_right)
```

## Luci_Keeb/Kconfig.defconfig
```kconfig
if SHIELD_Luci_Keeb_LEFT

config ZMK_KEYBOARD_NAME
    default "Luci_Keeb"

config ZMK_SPLIT_ROLE_CENTRAL
    default y

endif

if SHIELD_Luci_Keeb_LEFT || SHIELD_Luci_Keeb_RIGHT

config ZMK_SPLIT
    default y

endif
```

## Luci_Keeb/Kconfig.shield
```kconfig
config SHIELD_Luci_Keeb_LEFT
	def_bool $(shields_list_contains,Luci_Keeb_left)

config SHIELD_Luci_Keeb_RIGHT
	def_bool $(shields_list_contains,Luci_Keeb_right)
```
